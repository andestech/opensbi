## lib/utils/cache/Kconfig
```kconfig
# SPDX-License-Identifier: BSD-2-Clause

menu "Cache Controller Support"

config FDT_CACHE
	bool "FDT based cache controllers"
	depends on FDT
	select CACHE
	default n

config CACHE
	bool "Cache controller support"
	default n

endmenu
```

## lib/utils/rpxy/Kconfig
```kconfig
# SPDX-License-Identifier: BSD-2-Clause

menu "RPXY Device Support"

config FDT_RPXY
	bool "FDT based RPXY drivers"
	depends on FDT
	default n

if FDT_RPXY
config FDT_RPXY_SPD
	bool "FDT RPXY SPD client driver"
	default n

endif
endmenu
```

## platform/generic/andes/Kconfig
```kconfig
# SPDX-License-Identifier: BSD-2-Clause

config ANDES_TRIGGER
	bool "Andes Trigger support"
	default n

config ANDES_PMA
	bool "Andes PMA support"
	default n

config ANDES_SBI
	bool "Andes SBI support"
	select ANDES_TRIGGER
	select ANDES_PMA
	select FDT_CACHE
	default n
```

## platform/generic/configs/defconfig
```kconfig
CONFIG_PLATFORM_ANDES_AE350=y
CONFIG_FDT_IPI=y
CONFIG_FDT_IPI_PLICSW=y
CONFIG_FDT_IRQCHIP=y
CONFIG_FDT_IRQCHIP_PLIC=y
CONFIG_FDT_RESET=y
CONFIG_FDT_RESET_ATCWDT200=y
CONFIG_FDT_SERIAL=y
CONFIG_FDT_SERIAL_UART8250=y
CONFIG_FDT_TIMER=y
CONFIG_FDT_TIMER_PLMT=y
CONFIG_ANDES_TRIGGER=y
CONFIG_ANDES_PMA=y
```
